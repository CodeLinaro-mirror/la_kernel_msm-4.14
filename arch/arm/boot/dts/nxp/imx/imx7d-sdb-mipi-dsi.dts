/*
 * Copyright (C) 2016 Freescale Semiconductor, Inc.
 *
 * This program is free software; you can redistribute it and/or modify
 * it under the terms of the GNU General Public License version 2 as
 * published by the Free Software Foundation.
 */

#include "imx7d-sdb.dts"

&lcdif {
	disp-dev = "mipi_dsi_samsung";
	disp-videomode = "TRUULY-WVGA-SYNC-LOW";
};

&mipi_dsi {
	pinctrl-names = "default";
	pinctrl-0 = <&pinctrl_mipi_dsi_reset>;
	lcd_panel = "TRULY-WVGA-TFT3P5581E";
	reset-gpios = <&gpio6 15 GPIO_ACTIVE_LOW>;
	status = "okay";
};
